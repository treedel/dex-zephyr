## CMakeLists.txt
```
#pico-zephyr-project
#-------------------------------------------------------------------------------
# Zephyr Example Application
#
# Copyright (c) 2021 Nordic Semiconductor ASA
# SPDX-License-Identifier: Apache-2.0
#-------------------------------------------------------------------------------
# NOTE: Please do not remove the #pico-zephyr-project header, it is used by
# the Raspberry Pi Pico VS Code extension to identify the project type.
#-------------------------------------------------------------------------------

cmake_minimum_required(VERSION 3.20.0)
find_package(Zephyr REQUIRED HINTS $ENV{ZEPHYR_BASE})

project(comms LANGUAGES C)

add_subdirectory(modules)

zephyr_library_include_directories(
    include
)

target_sources(app PRIVATE 
    src/main.c
)
```

## prj.conf
```kconfig
# For easy MCU handling
CONFIG_REBOOT=y

# Shell configuration
CONFIG_SHELL=y
CONFIG_SHELL_MINIMAL=y
CONFIG_SHELL_STACK_SIZE=1024
CONFIG_SHELL_BACKEND_SERIAL=y

# Logging (global defaults)
CONFIG_LOG=y
CONFIG_NET_LOG=y
CONFIG_LOG_PRINTK=y
CONFIG_LOG_DEFAULT_LEVEL=3

# Configure networking stack
CONFIG_NETWORKING=y
CONFIG_NET_IPV4=y
CONFIG_NET_DHCPV4=y
CONFIG_NET_L2_ETHERNET=y
CONFIG_WIFI=y
CONFIG_NET_MGMT_EVENT=y
CONFIG_NET_MGMT_EVENT_QUEUE_SIZE=16
CONFIG_NET_MGMT_EVENT_QUEUE_TIMEOUT=5000
CONFIG_TEST_RANDOM_GENERATOR=y
CONFIG_MAIN_STACK_SIZE=4096
CONFIG_NET_TX_STACK_SIZE=2048
CONFIG_NET_RX_STACK_SIZE=2048

# App configuration
CONFIG_NET_SOCKETS=y
CONFIG_NET_TCP=y

CONFIG_NANOPB=y
```

## src/main.c
```c
#include <zephyr/kernel.h>
#include <zephyr/logging/log.h>

#include <wifi.h>
#include <wifi_info.h>
#include <tcp.h>
#include <string.h>

#include <dex_registry.h>


LOG_MODULE_REGISTER(main, CONFIG_LOG_DEFAULT_LEVEL);

#define BIND_PORT 4343

int server, client;


bool tcp_send_frame(void* buffer, size_t buffer_length) {
	tcp_send_data(client, buffer, buffer_length);
	return true;
}

int main(void) {
	printk("Attempting to connect to WiFi\n");
	wifi_connect(WIFI_SSID, WIFI_PSK);
	
	server = tcp_start_server(BIND_PORT);

	while (1) {
		client = tcp_accept_connection(server);
		if (client >= 0) {
			DexContext ctx;
			dex_initalize(&ctx, tcp_send_frame);
			
			uint8_t id;
			dex_register_topic(&ctx, "TopicA", DexMessageType_MSG_DAT_MOT, &id);
			printk("%d\n", id);
			k_sleep(K_MSEC(1000));
			dex_register_topic(&ctx, "TopicB", DexMessageType_MSG_DAT_MOT, &id);
			printk("%d\n", id);
			k_sleep(K_MSEC(1000));
			dex_register_topic(&ctx, "TopicC", DexMessageType_MSG_DAT_ENC, &id);
			printk("%d\n", id);
			k_sleep(K_MSEC(1000));
			dex_register_topic(&ctx, "TopicD", DexMessageType_MSG_DAT_ENC, &id);
			printk("%d\n", id);
			k_sleep(K_MSEC(1000));
			dex_register_topic(&ctx, "TopicE", DexMessageType_MSG_DAT_MOT, &id);
			printk("%d\n", id);
			k_sleep(K_MSEC(1000));
			dex_register_topic(&ctx, "TopicF", DexMessageType_MSG_DAT_MOT, &id);
			printk("%d\n", id);
			k_sleep(K_MSEC(1000));
			dex_register_topic(&ctx, "TopicG", DexMessageType_MSG_DAT_MOT, &id);
			printk("%d\n", id);
			k_sleep(K_MSEC(1000));
			dex_register_topic(&ctx, "TopicH", DexMessageType_MSG_DAT_MOT, &id);
			printk("%d\n", id);
			k_sleep(K_MSEC(1000));

            tcp_close_connection(client);
        }
	}

	return 0;
}



/* #include <zephyr/kernel.h>
#include <zephyr/logging/log.h>

#include <wifi.h>
#include <wifi_info.h>
#include <tcp.h>
#include <string.h>


LOG_MODULE_REGISTER(main, CONFIG_LOG_DEFAULT_LEVEL);

int main(void) {
	printk("CPUs: %d\n", arch_num_cpus());
	printk("Attempting to connect to WiFi\n");
	wifi_connect(WIFI_SSID, WIFI_PSK);

	int server, client;
	
	server = start_server(BIND_PORT);

	while (1) {
		client = accept_connection(server);
		if (client >= 0) {
            
			while (1) {
				size_t buffer_length = 128;
				char buffer[buffer_length];

				int len = read_data(client, (void*) buffer, buffer_length);
				
				// For identifying data as string
				buffer[len++] = '\0';

				// Exit condition
				if (!strcmp(buffer, "/close\r\n")) {
					break;
				}

				printk("%s", buffer);

				// Acknowledgement
				send_data(client, (void*) "OK\n", 4);
			}

            close_connection(client);
        }
	}

	return 0;
}
 */
```

## include/wifi_info.h
```c
#ifndef WIFI_INFO_H
#define WIFI_INFO_H

#define WIFI_SSID "ssid"
#define WIFI_PSK "psk"

#endif
```
